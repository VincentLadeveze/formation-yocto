## Yocto-lab/build-bbb/conf/bblayers.conf
```bitbake
# POKY_BBLAYERS_CONF_VERSION is increased each time build/conf/bblayers.conf
# changes incompatibly
POKY_BBLAYERS_CONF_VERSION = "2"

BBPATH = "${TOPDIR}"
BBFILES ?= ""

BBLAYERS ?= " \
  /home/ladeveze/workspace/morgue2021/embedded_linux/yocto/ChristopheBlaess2020/Yocto-lab/poky/meta \
  /home/ladeveze/workspace/morgue2021/embedded_linux/yocto/ChristopheBlaess2020/Yocto-lab/poky/meta-poky \
  /home/ladeveze/workspace/morgue2021/embedded_linux/yocto/ChristopheBlaess2020/Yocto-lab/poky/meta-yocto-bsp \
  "
```

## Yocto-lab/build-rpi/conf/bblayers.conf
```bitbake
# POKY_BBLAYERS_CONF_VERSION is increased each time build/conf/bblayers.conf
#  /media/ladeveze/Storage/workspace_storage/linux/distributions/formation-yocto-up-to-date/Yocto-lab/meta-tutorial-layer \
# changes incompatibly
POKY_BBLAYERS_CONF_VERSION = "2"

BBPATH = "${TOPDIR}"
BBFILES ?= ""

BBLAYERS ?= " \
  /media/ladeveze/Storage/workspace_storage/linux/distributions/formation-yocto-up-to-date/Yocto-lab/poky/meta \
  /media/ladeveze/Storage/workspace_storage/linux/distributions/formation-yocto-up-to-date/Yocto-lab/poky/meta-poky \
  /media/ladeveze/Storage/workspace_storage/linux/distributions/formation-yocto-up-to-date/Yocto-lab/poky/meta-yocto-bsp \
  /media/ladeveze/Storage/workspace_storage/linux/distributions/formation-yocto-up-to-date/Yocto-lab/meta-raspberrypi \
  /media/ladeveze/Storage/workspace_storage/linux/distributions/formation-yocto-up-to-date/Yocto-lab/meta-openembedded/meta-oe \
  /media/ladeveze/Storage/workspace_storage/linux/distributions/formation-yocto-up-to-date/Yocto-lab/meta-python2 \
  "
```

## Yocto-lab/meta-tutorial-layer/conf/layer.conf
```bitbake
# We have a conf and classes directory, add to BBPATH
BBPATH .= ":${LAYERDIR}"

# We have recipes-* directories, add to BBFILES
BBFILES += "${LAYERDIR}/recipes-*/*/*.bb \
            ${LAYERDIR}/recipes-*/*/*.bbappend"

BBFILE_COLLECTIONS += "meta-tutorial-layer"
BBFILE_PATTERN_meta-tutorial-layer = "^${LAYERDIR}/"
BBFILE_PRIORITY_meta-tutorial-layer = "6"

LAYERDEPENDS_meta-tutorial-layer = "core"
LAYERSERIES_COMPAT_meta-tutorial-layer = "kirkstone"
```
